#include "init_code.h"
#include "ssd2828.h"
#include "systick.h"
#include "sd_file.h"
#include <stdio.h>
#include "string.h"
#include "stm_spi.h"



extern char LOG_filename[64];	//log文件名
extern char Code_file[32];

struct init_code
{
	unsigned char delay;          //读等待的时间(华视1.72项目改成 =1为读checksum)
	unsigned char package_long;   //读的长度
	unsigned char data[6];       //需要回读判断的数据，第一位为地址
}
init_code[]=
{
    {0,2,{0xFE,0x40}},
    {0,2,{0xD8,0x33}},
    {0,2,{0xD9,0x11}},
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    {0,2,{0xA2,0x07}}
},*p=&init_code[0];


unsigned char RD_code[8];
int ReadALLcode(void)
{
    unsigned short i,j,k;
	int	result = 1;
//	char src[32];
	char dest[512]; //数据缓存
    p=&init_code[0];
	memset(dest,0x00,sizeof(dest));

	SPI_Write(0xFE,0x20);
  	SPI_Write(0xF4,0x5A);
  	SPI_Write(0xF5,0x59);

	printf("read star\r\n"); 
  	_DEBUG("read star\r\n");  
    for(i=0;i<(sizeof(init_code)/sizeof(init_code[0]));i++,p++)
    {
		if(p->data[0]==0xFE)//Switch page
		{	
//			SDCard_Printf(LOG_filename,dest);  //把缓存的数据保存在SD卡
//			memset(dest,0x00,sizeof(dest));    //清空缓存

			SPI_Write(p->data[0],p->data[1]);	
			printf("0x%02X,0x%02X:\r\n",p->data[0],p->data[1]);
//			_DEBUG("Page 0x%02x\r\n",p->data[1]);
//			sprintf(src,"  W:0x%02x;0x%02x;",p->data[0],p->data[1]);  
//			SDCard_Printf(LOG_filename,src);//保存LOG
		}else
		{
			
			SPI_Read_Buffer(p->data[0],(uint16_t *)RD_code, (p->package_long)-1);
			// printf("0x%02x,",p->data[0]);
			for(j=0;j<p->package_long-1;j++)
			{
				if(p->data[j+1] == RD_code[j])   //compare read data and save
				{
						// printf("0x%02x,",RD_code[j]);

//						sprintf(src,"0x%02x;",p->data[j]);
//						strcat(dest, src); //放入缓存

				}else	//Read code error
				{
					printf("0x%02x->0x%02x Fail,",p->data[0],RD_code[j]);
//						printf("0x%02x->0x%02x Fail,",p->data[1],RD_code[j]);
//						sprintf(src,"0x%02x->0x%02x;",p->data[1],RD_code[j]);
//						strcat(dest, src); //放入缓存

					result = -1;
					break;
				}					
			}
			// printf("\r\n");

		}
		if( i/20 )
		{
//			SDCard_Printf(LOG_filename,dest);  //把缓存的数据保存在SD卡
			memset(dest,0x00,sizeof(dest));    //清空缓存
		}
    }
//	SDCard_Printf(LOG_filename,",");
//	_DEBUG("read end: %d \r\n",result);
			_DEBUG("read end: %s \r\n",result == 1 ? "OK" : "NG");
	
/*--2828进入HS or video模式--*/
    // if(PD_CommandMode())
    // {
    //     SSD2828_HS();
    // }
    // else
    // {
    //     SSD2828_Video();
    // }

	
    return result;
}



//unsigned char RD_code[255];
//int ReadALLcode(void)
//{
//    unsigned short i,j,k;
//	int	result = 1;
////	char src[32];
//	char dest[512]; //数据缓存
//    p=&init_code[0];
//	memset(dest,0x00,sizeof(dest));

//	SPI_Write(0x00,0x00);
//	SPI_Write(0xFF,0x23,0x90,0x01,0x01);

//	SPI_Write(0x00,0x80);
//	SPI_Write(0xFF,0x23,0x90);

//	printf("read star\r\n"); 
//  	_DEBUG("read star\r\n");  
//    for(i=0;i<(sizeof(init_code)/sizeof(init_code[0]));i++,p++)
//    {
//		if(p->data[0]==0x00)//Switch page
//		{	
////			SDCard_Printf(LOG_filename,dest);  //把缓存的数据保存在SD卡
////			memset(dest,0x00,sizeof(dest));    //清空缓存

//			SPI_Write(p->data[0],p->data[1]);	
//			printf("0x%02X,0x%02X:\r\n",p->data[0],p->data[1]);
////			_DEBUG("Page 0x%02x\r\n",p->data[1]);
////			sprintf(src,"  W:0x%02x;0x%02x;",p->data[0],p->data[1]);  
////			SDCard_Printf(LOG_filename,src);//保存LOG
//		}else
//		{
//			
//			SPI_Read_Buffer(p->data[0],(uint16_t *)RD_code, (p->package_long)-1);
//			// printf("0x%02x,",p->data[0]);
//			for(j=0;j<p->package_long-1;j++)
//			{
//				if(p->data[j+1] == RD_code[j])   //compare read data and save
//				{
//						// printf("0x%02x,",RD_code[j]);

////						sprintf(src,"0x%02x;",p->data[j]);
////						strcat(dest, src); //放入缓存

//				}else	//Read code error
//				{
//					printf("0x%02x->0x%02x Fail,",p->data[0],RD_code[j]);
////						printf("0x%02x->0x%02x Fail,",p->data[1],RD_code[j]);
////						sprintf(src,"0x%02x->0x%02x;",p->data[1],RD_code[j]);
////						strcat(dest, src); //放入缓存

//					result = -1;
//					break;
//				}					
//			}
//			// printf("\r\n");

//		}
//		if( i/20 )
//		{
////			SDCard_Printf(LOG_filename,dest);  //把缓存的数据保存在SD卡
//			memset(dest,0x00,sizeof(dest));    //清空缓存
//		}
//    }
////	SDCard_Printf(LOG_filename,",");
//	_DEBUG("read end: %d \r\n",result);
//	
///*--2828进入HS or video模式--*/
//    // if(PD_CommandMode())
//    // {
//    //     SSD2828_HS();
//    // }
//    // else
//    // {
//    //     SSD2828_Video();
//    // }
//	SPI_Write(0x00,0x00);
//	SPI_Write(0xFF,0x23,0x90,0x01,0x00);
//	
//    return result;
//}














